## drivers/net/datapath/dpm/gswip31/Kconfig
```kconfig
menuconfig INTEL_DATAPATH_HAL_GSWIP31
	bool "Datapath HAL_GSWIP31"
	default y
	depends on INTEL_DATAPATH && PRX300_CQM
	---help---
	  Datapath Lib is to provide common rx/tx wrapper Lib without taking
	  care of much HW knowledge and also provide common interface for legacy
	  devices and different HW like to CBM or LRO.
	  Take note: All devices need to register to datapath Lib first

if INTEL_DATAPATH_HAL_GSWIP31
config INTEL_DATAPATH_HAL_GSWIP31_MIB
	bool "Datapath aggregated mib support"
	depends on INTEL_DATAPATH_HAL_GSWIP30 && SOC_GRX500 && LTQ_TMU && LTQ_PPA_TMU_MIB_SUPPORT
	default y
	---help---
	  It is to aggregate GSWIP-L/R, TMU and driver's MIB counter

config INTEL_DATAPATH_DDR_SIMULATE_GSWIP31
	bool "Datapath Simulation GSWIP3.1 based on GRX500 board"
	default n
	depends on INTEL_DATAPATH_DBG
	---help---
		Datapath Debug Tool for GSWIP DDR simulation
		Only for debugging purpose
		By default it should be disabled.

config INTEL_DATAPATH_DUMMY_QOS
	bool "datapath dummy QOS based on slim QOS driver or real QOS API with PRX300_test API"
	depends on LTQ_PPV4_QOS_SLIM || (LTQ_PPV4_QOS || LTQ_PPV4)

config INTEL_DATAPATH_DUMMY_QOS_VIA_PRX300_TEST
	bool "datapath dummy QOS via ppv4 qos driver's PRX300_test api, like slim driver"
	depends on (LTQ_PPV4_QOS || LTQ_PPV4) && !LTQ_PPV4_QOS_SLIM && INTEL_DATAPATH_DUMMY_QOS

config INTEL_DATAPATH_QOS_HAL
	bool "datapath QOS hal"
	default y
	depends on (LTQ_PPV4_QOS || LTQ_PPV4) && !INTEL_DATAPATH_DUMMY_QOS_VIA_PRX300_TEST
endif
```

## drivers/net/ethernet/lantiq/cqm/falconmx/Kconfig
```kconfig
#
# Central Buffer Manager(CBM) configuration
#
menu "CQM_FALCONMX"
config CQM_QMGR_NUM_DESC
	hex "Number of QMGR Descriptors supported "
	depends on LTQ_CBM
	default 0x2000
	---help---
	Number of descriptors to be supported.128 bits of memory for each descriptor will be allocated
	e.g 8192 descriptors * 128 bits (size of each descriptor)

config CQM_SIZE0_BUF_SIZE
	hex "CQM size0 Buffer size"
	depends on LTQ_CBM
	default 0x800
	---help---
	possible sizes are 128B, 256B, 512B, 1KB, 2KB, 4KB, 8KB, 10KB

config CQM_NUM_SIZE0_BUF
	hex "number of size0 buffers"
	depends on LTQ_CBM
	default 0x80

config CQM_SIZE1_BUF_SIZE 
	hex "CQM size1 Buffer size"
	depends on LTQ_CBM
	default 0x800
	---help---
	possible sizes are 128B, 256B, 512B, 1KB, 2KB, 4KB, 8KB, 10KB

config CQM_NUM_SIZE1_BUF
	hex "number of size1 buffers"
	depends on LTQ_CBM
	default 0x80

config CQM_SIZE2_BUF_SIZE 
	hex "CQM size2 Buffer size"
	depends on LTQ_CBM
	default 0x800
	---help---
	possible sizes are 128B, 256B, 512B, 1KB, 2KB, 4KB, 8KB, 10KB

config CQM_NUM_SIZE2_BUF
	hex "number of size2 buffers"
	depends on LTQ_CBM
	default 0x80

config CQM_SIZE3_BUF_SIZE 
	hex "CQM size3 Buffer size"
	depends on LTQ_CBM
	default 0x800
	---help---
	possible sizes are 128B, 256B, 512B, 1KB, 2KB, 4KB, 8KB, 10KB

config CQM_NUM_SIZE3_BUF
	hex "number of size3 buffers"
	depends on LTQ_CBM
	default 0x80

config CBM_LS_ENABLE
	tristate "CBM loadspreader"
	depends on LTQ_CBM
	default n
	---help---
	Turn on this option to enable CBM LS and TCP packet Marking
	in HW.
endmenu
```

## drivers/net/ethernet/lantiq/datapath/Kconfig
```kconfig
#
# Datapath Lib
#
menuconfig LTQ_DATAPATH
	bool "Datapath LIB"
	default y
	depends on LTQ_CBM
	---help---
	  Datapath Lib is to provide common rx/tx wrapper Lib without taking
	  care of much HW knowledge and also provide common interface for legacy
	  devices and different HW like to CBM or LRO.
	  Take note: All devices need to register to datapath Lib first

if LTQ_DATAPATH

config LTQ_DATAPATH_ACA_CSUM_WORKAROUND
	bool "ACA Checksum Workaround"
	default n
	depends on SOC_GRX500 && LTQ_DATAPATH
	---help---
	  It is to solve system bus hang hang issue in GRX500
	  Once there is SW-UMT, there is no need to enable it
	  in Facon-MX and later SOC, HW bug is fixed already
	  So it should be disabled

config LTQ_DATAPATH_MANUAL_PARSE
	bool "Datapath manual parse network protocol"
	depends on LTQ_DATAPATH
	default y
	---help---
	  Manual parse network protocol for tcp offloading
	  Only support limited tunnel yet
	  later need to enhance to support other tunnels
	  Also need to study to use network stack information

config LTQ_DATAPATH_COPY_LINEAR_BUF_ONLY
	bool "Datapath Copy linear buffer only for skb"
	default n
	depends on LTQ_DATAPATH
	---help---
	  Datapath Copy linear buffer only for skb if need to alloc new buffer.
	  For TSO/GSO case, it will not consider
	  Make sure TSO/GSO always with enough header room to insert pmac header
	  need to enhance in the future

config LTQ_DATAPATH_DBG
	bool "Datapath Debug Tool"
	default y
	depends on LTQ_DATAPATH
	---help---
	  Datapath Debug Tool is used to provide simple debug tool
	  All other debug tools is based on it
	  Once it is disabled, all other datapath debug tool disabled.
	  By default had better enable it

config LTQ_DATAPATH_DBG_PROTOCOL_PARSE
	bool "Datapath Debug Tool for hw checksum's protocol parsing"
	default n
	depends on LTQ_DATAPATH_DBG
	---help---
	  Datapath Debug Tool for hw checksum's protocol parsing
	  Only for debugging purpose
	  By default it should be disabled.
config LTQ_DATAPATH_EXTRA_DEBUG
	bool "extra debugging support"
	default n
	depends on  LTQ_DATAPATH_DBG
	---help---
	  This is to enable/disable extra strict debugging support.
	  This is useful during initial system bring up
	  It will affect performance
	  By default it should be disabled.

config LTQ_DATAPATH_SWDEV_TEST
	bool "Test Switchdev Event"
	default n
	depends on  LTQ_DATAPATH_DBG && LTQ_DATAPATH_SWITCHDEV
	---help---
	  This is to force enable macro CONFIG_SOC_SWITCHDEV_TESTING
	  in order to test switchdev event
	  without real switchdev handling

config LTQ_DATAPATH_SKB
	bool "Datapath Skb Hack"
	default n
	depends on  LTQ_DATAPATH
	---help---
	  For Ethernet OAM and MPE FW purpose testing purpose,
	  It needs to hack SKB

config LTQ_DATAPATH_MPE_FASTHOOK_TEST
	bool "MPE Fast Hook Test"
	default n
	depends on  LTQ_DATAPATH_SKB
	---help---
	  MPE FW Fast Hook is used to quick verify MPE FW Functionality without
	  full PPA support. Once it is enabled, it will add some fields in skb structure
	  in order to support MPE FAST HOOK. The reason is that some network driver is
	  pre-build out of this build system.
	  The testing code by default is not checked in.

config LTQ_DATAPATH_ETH_OAM
	bool "ETH OAM SUPPORT"
	default n
	depends on  LTQ_DATAPATH_SKB
	---help---
	  Datapath Ethernet OAM support. Once it is enabled, it will add some fields in skb structure
	  in order to support MPE FAST HOOK. The reason is that some network driver is
	  pre-build out of this build system.
	  The testing code by default is not checked in.

config LTQ_DATAPATH_SWITCHDEV
	bool "Switchdev Support"
	default n
	depends on  LTQ_DATAPATH && NET_SWITCHDEV
	---help---
	  Switchdev support for different switch in datapath

config LTQ_DATAPATH_PTP1588
	bool "PTP1588 Support"
	default n
	depends on  LTQ_DATAPATH
	---help---
	  PTP1588 support in datapath

config LTQ_DATAPATH_PTP1588_SW_WORKAROUND
        bool "PTP1588 Software Workaround"
        default n
        depends on  LTQ_DATAPATH && LTQ_DATAPATH_PTP1588
        ---help---
          PTP1588 Software Workaround

config LTQ_DATAPATH_DDR_SIMULATE_GSWIP31
	bool "Force PRX300 SOC"
	default n
	depends on LTQ_DATAPATH
	---help---
	  test prx300 HAL in GRX350 boards

config LTQ_DATAPATH_CPUFREQ
	bool "Datapath DFS(COC) support"
	depends on LTQ_DATAPATH && CPU_FREQ
	default n
	---help---
	  It is to support DFS(COC) in Datapath

config INTEL_DATAPATH
	bool
	depends on LTQ_DATAPATH
	default y

config INTEL_DATAPATH_ACA_CSUM_WORKAROUND
	bool
	default y
	depends on SOC_GRX500 && INTEL_DATAPATH && LTQ_DATAPATH_ACA_CSUM_WORKAROUND

config INTEL_DATAPATH_MANUAL_PARSE
	bool
	default y
	depends on INTEL_DATAPATH && LTQ_DATAPATH_MANUAL_PARSE

config INTEL_DATAPATH_COPY_LINEAR_BUF_ONLY
	bool
	default y
	depends on INTEL_DATAPATH && LTQ_DATAPATH_COPY_LINEAR_BUF_ONLY

config INTEL_DATAPATH_DBG
	bool
	default y
	depends on INTEL_DATAPATH && LTQ_DATAPATH_DBG

config INTEL_DATAPATH_DBG_PROTOCOL_PARSE
	bool
	default y
	depends on INTEL_DATAPATH_DBG && LTQ_DATAPATH_DBG_PROTOCOL_PARSE

config INTEL_DATAPATH_EXTRA_DEBUG
	bool
	default y
	depends on  INTEL_DATAPATH_DBG && LTQ_DATAPATH_EXTRA_DEBUG

config INTEL_DATAPATH_SWDEV_TEST
	bool
	default y
	depends on  INTEL_DATAPATH_DBG && INTEL_DATAPATH_SWITCHDEV && LTQ_DATAPATH_SWDEV_TEST

config INTEL_DATAPATH_SKB
	bool
	default y
	depends on  INTEL_DATAPATH && LTQ_DATAPATH_SKB

config INTEL_DATAPATH_MPE_FASTHOOK_TEST
	bool
	default y
	depends on  INTEL_DATAPATH_SKB && LTQ_DATAPATH_MPE_FASTHOOK_TEST

config INTEL_DATAPATH_ETH_OAM
	bool
	default y
	depends on  INTEL_DATAPATH_SKB && LTQ_DATAPATH_ETH_OAM

config INTEL_DATAPATH_SWITCHDEV
	bool
	default y
	depends on  INTEL_DATAPATH && LTQ_DATAPATH_SWITCHDEV

config INTEL_DATAPATH_PTP1588
	bool
	default y
	depends on  INTEL_DATAPATH && LTQ_DATAPATH_PTP1588

config INTEL_DATAPATH_PTP1588_SW_WORKAROUND
	bool
	default y
        depends on  INTEL_DATAPATH && INTEL_DATAPATH_PTP1588 && LTQ_DATAPATH_PTP1588_SW_WORKAROUND

config INTEL_DATAPATH_DDR_SIMULATE_GSWIP31
	bool
	default y
	depends on INTEL_DATAPATH && LTQ_DATAPATH_DDR_SIMULATE_GSWIP31

config INTEL_DATAPATH_CPUFREQ
	bool
	default y
	depends on INTEL_DATAPATH && CPU_FREQ && LTQ_DATAPATH_CPUFREQ

source "drivers/net/ethernet/lantiq/datapath/gswip31/Kconfig"
source "drivers/net/ethernet/lantiq/datapath/gswip30/Kconfig"
endif
```

## drivers/net/ethernet/lantiq/datapath/gswip30/Kconfig
```kconfig
menuconfig LTQ_DATAPATH_HAL_GSWIP30
	bool "Datapath HAL_GSWIP30"
	default y
	depends on LTQ_DATAPATH && GRX500_CBM
	---help---
	  Datapath Lib is to provide common rx/tx wrapper Lib without taking
	  care of much HW knowledge and also provide common interface for legacy
	  devices and different HW like to CBM or LRO.
	  Take note: All devices need to register to datapath Lib first

if LTQ_DATAPATH_HAL_GSWIP30
config LTQ_DATAPATH_HAL_GSWIP30_MIB
	bool "Datapath aggregated mib support"
	depends on LTQ_DATAPATH_HAL_GSWIP30 && SOC_GRX500 && LTQ_TMU && LTQ_PPA_TMU_MIB_SUPPORT
	default y
	---help---
	  It is to aggregate GSWIP-L/R, TMU and driver's MIB counter

endif
```
